static const uint8_t cabac_transition_5ones[128] = {
   0,   1,  96,   3,  96,   3, 100,   3, 100,   3, 100,   3, 100,   3, 100,   5,
 100,   7, 100,   9, 100,  11, 100,  13, 100,  15, 100,  17, 102,  19, 102,  21,
 102,  23, 102,  25, 102,  27, 102,  29, 102,  31, 102,  33, 102,  35, 102,  37,
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 126, 103, 127, 105, 127, 107, 125, 109, 125, 111, 123, 113, 121, 115, 119, 117,
};

static const uint16_t cabac_size_5ones[128] = {
  7601,   291,  4768,   291,  4749,   292,  4635,   293,
  4616,   295,  4596,   297,  4558,   300,  4539,   302,
  4520,   305,  4461,   307,  4442,   310,  4423,   312,
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  1652,  1159,  1576,  1223,  1502,  1293,  1433,  1369,
};

